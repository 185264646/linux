## Documentation/devicetree/bindings/bus/hisilicon,hi3798cv200-usb2phy-test-bus.yaml
```yaml
# SPDX-License-Identifier: (GPL-2.0 OR BSD-2-Clause)
%YAML 1.2
---
$id: http://devicetree.org/schemas/bus/hisilicon,hi3798cv200-usb2phy-test-bus.yaml#
$schema: http://devicetree.org/meta-schemas/core.yaml#

title: HiSilicon HiSTB SoCs INNO USB2 PHY test bus

description:
  Some HiSilicon HiSTB SoCs have a special register in PERICTRL module. It
  implements a proprietary bus called "PHY test bus", which is used to configure
  the PHY (currently only INNO USB2 PHY).  This bus also provide a clock for itself.

maintainers:
  - Yang Xiwen <forbidden405@outlook.com>

properties:
  compatible:
    enum:
      - hisilicon,hi3798mv100-usb2phy-test-bus
      - hisilicon,hi3798cv200-usb2phy-test-bus

  reg:
    maxItems: 1

  clocks:
    maxItems: 1
    description: bus clock

  '#clock-cells':
    const: 0

  usb2phy:
    $ref: ../phy/hisilicon,inno-usb2-phy.yaml#

required:
  - compatible
  - reg
  - clocks
  - usb2phy

additionalProperties: false

examples:
  - |
    perictrl@8a20000 {
        compatible = "hisilicon,hi3798cv200-perictrl", "syscon", "simple-mfd";
        reg = <0x8a20000 0x1000>;
        #address-cells = <1>;
        #size-cells = <1>;
        ranges = <0x0 0x8a20000 0x1000>;

        usb2phy_test_bus: usb2phy-test-bus@124 {
            compatible = "hisilicon,hi3798cv200-usb2phy-test-bus";
            reg = <0x124 0x4>;
            clocks = <&usb2phy_test_bus>;
            #clock-cells = <0>;

            usb2phy {
                compatible = "hisilicon,hi3798cv200-usb2-phy", "hisilicon,inno-usb2-phy";
                clocks = <&clk_ref>;
                resets = <&crg 0xbc 6>;
                #address-cells = <1>;
                #size-cells = <0>;

                phy@0 {
                    reg = <0>;
                    #phy-cells = <0>;
                    resets = <&crg 0xbc 10>;
                };
            };
        };
    };
...
```

## Documentation/devicetree/bindings/mmc/histb-dw-mshc.yaml
```yaml
# SPDX-License-Identifier: GPL-2.0
%YAML 1.2
---
$id: http://devicetree.org/schemas/mmc/histb-dw-mshc.yaml#
$schema: http://devicetree.org/meta-schemas/core.yaml#

title:
  Hisilicon Hi3798CV200 specific extensions to the Synopsys Designware Mobile
  Storage Host Controller

maintainers:
  - Yang Xiwen <forbidden405@outlook.com>

description:
  The Synopsys designware mobile storage host controller is used to interface
  a SoC with storage medium such as eMMC or SD/MMC cards. This file documents
  differences between the core Synopsys dw mshc controller properties described
  by synopsys-dw-mshc.txt and the properties used by the Hisilicon Hi3798CV200
  specific extensions to the Synopsys Designware Mobile Storage Host Controller.

allOf:
  - $ref: "synopsys-dw-mshc-common.yaml#"
  - if:
      properties:
        compatible:
          contains:
            const: hisilicon,hi3798mv200-dw-mshc
    then:
      properties:
        clocks:
          minItems: 5

        clock-names:
          minItems: 5

properties:
  compatible:
    enum:
      - hisilicon,hi3798cv200-dw-mshc
      - hisilicon,hi3798mv200-dw-mshc

  reg:
    maxItems: 1

  interrupts:
    maxItems: 1

  clocks:
    minItems: 4
    maxItems: 5
    description: A list of phandles for the clocks listed in clock-names

  clock-names:
    minItems: 4
    items:
      - const: ciu
      - const: biu
      - const: ciu-sample
      - const: ciu-drive
      - const: sap-dll-mode

unevaluatedProperties: false

required:
  - compatible
  - reg
  - interrupts
  - clocks
  - clock-names

examples:
  - |
    emmc: mmc@9830000 {
            compatible = "hisilicon,hi3798cv200-dw-mshc";
            reg = <0x9830000 0x10000>;
            interrupts = <35>;
            clocks = <&crg 1>,
                     <&crg 2>,
                     <&crg 3>,
                     <&crg 4>;
            clock-names = "ciu", "biu", "ciu-sample", "ciu-drive";
            fifo-depth = <256>;
            clock-frequency = <200000000>;
            cap-mmc-highspeed;
            mmc-ddr-1_8v;
            mmc-hs200-1_8v;
            non-removable;
            bus-width = <8>;
    };
```

## Documentation/devicetree/bindings/net/hisilicon-femac-mdio.yaml
```yaml
# SPDX-License-Identifier: GPL-2.0
%YAML 1.2
---
$id: http://devicetree.org/schemas/net/hisilicon-femac-mdio.yaml#
$schema: http://devicetree.org/meta-schemas/core.yaml#

title: Hisilicon Fast Ethernet MDIO Controller interface

maintainers:
  - Yang Xiwen <forbidden405@outlook.com>

allOf:
  - $ref: "mdio.yaml#"

properties:
  compatible:
    const: hisilicon,hisi-femac-mdio

  reg:
    description: address and length of the register set for the device.
    maxItems: 1

  clocks:
    description: A phandle to the reference clock for this device.
    maxItems: 1

required:
  - compatible
  - reg

unevaluatedProperties: false

examples:
  - |
    mdio: mdio@10091100 {
        compatible = "hisilicon,hisi-femac-mdio";
        reg = <0x10091100 0x10>;
        clocks = <&crg 38>;
        #address-cells = <1>;
        #size-cells = <0>;

        phy0: phy@1 {
                reg = <1>;
        };
    };
```

## Documentation/devicetree/bindings/net/hisilicon-femac.yaml
```yaml
# SPDX-License-Identifier: GPL-2.0
%YAML 1.2
---
$id: http://devicetree.org/schemas/net/hisilicon-femac.yaml#
$schema: http://devicetree.org/meta-schemas/core.yaml#

title: Hisilicon Fast Ethernet MAC controller

maintainers:
  - Yang Xiwen <forbidden405@outlook.com>

allOf:
  - $ref: "ethernet-controller.yaml#"

properties:
  compatible:
    description: should contain one of the following version strings and the soc string.
    items:
      - enum:
          - "hisilicon,hi3516cv300-femac"
      - enum:
          - "hisilicon,hisi-femac-v1"
          - "hisilicon,hisi-femac-v2"

  reg:
    items:
      - description: the MAC core register base and size
      - description: the global MAC control register

  interrupts:
    maxItems: 1
    description: should contain the MAC interrupt

  clocks:
    minItems: 1
    description: A list of phandles to the MAC clocks

  resets:
    minItems: 1
    items:
      - description: the phandle to the MAC reset signal(required)
      - description: the phandle to the PHY reset signal(optional)

  reset-names:
    minItems: 1
    items:
      - const: mac
      - const: phy

  hisilicon,phy-reset-delays-us:
    description: triplet of delays if PHY reset signal given.
    items:
      - description: The 1st cell is reset pre-delay in micro seconds.
      - description: The 2nd cell is reset pulse in micro seconds.
      - description: The 3rd cell is reset post-delay in micro seconds.

unevaluatedProperties: false

examples:
  - |
        hisi_femac: ethernet@10090000 {
                compatible = "hisilicon,hi3516cv300-femac","hisilicon,hisi-femac-v2";
                reg = <0x10090000 0x1000>,<0x10091300 0x200>;
                interrupts = <12>;
                clocks = <&crg 38>;
                resets = <&crg 0xec 0>,<&crg 0xec 3>;
                reset-names = "mac","phy";
                mac-address = [00 00 00 00 00 00];
                phy-mode = "mii";
                phy-handle = <&phy0>;
                hisilicon,phy-reset-delays-us = <10000 20000 20000>;
        };
```

## Documentation/devicetree/bindings/phy/hisilicon,inno-usb2-phy.yaml
```yaml
# SPDX-License-Identifier: (GPL-2.0-only OR BSD-2-Clause)
%YAML 1.2
---
$id: http://devicetree.org/schemas/phy/hisilicon,inno-usb2-phy.yaml#
$schema: http://devicetree.org/meta-schemas/core.yaml#

title: HiSilicon HiSTB SoCs INNO USB2 PHY device

maintainers:
  - Yang Xiwen <forbidden405@outlook.com>

properties:
  compatible:
    items:
      - enum:
          - hisilicon,hi3798cv200-usb2-phy
          - hisilicon,hi3798mv100-usb2-phy
          - hisilicon,hi3798mv200-usb2-phy
      - const: hisilicon,inno-usb2-phy

  '#address-cells':
    const: 1

  '#size-cells':
    const: 0

  clocks:
    maxItems: 1
    description: reference clock

  resets:
    maxItems: 1

patternProperties:
  'phy@[0-9a-f]+':
    type: object
    additionalProperties: false
    description: individual ports provided by INNO PHY

    properties:
      reg:
        maxItems: 1
        description: port index

      '#phy-cells':
        const: 0

      resets:
        maxItems: 1

      phy_type:
        const: utmi

    required:
      - reg
      - '#phy-cells'
      - resets

required:
  - compatible
  - clocks
  - '#address-cells'
  - '#size-cells'
  - resets

additionalProperties: false

examples:
  - |
    usb2-phy {
        compatible = "hisilicon,hi3798cv200-usb2-phy", "hisilicon,inno-usb2-phy";
        clocks = <&clk_ref>;
        resets = <&crg 0xbc 4>;
        #address-cells = <1>;
        #size-cells = <0>;

        phy@0 {
            reg = <0>;
            #phy-cells = <0>;
            resets = <&crg 0xbc 8>;
        };
    };
```
